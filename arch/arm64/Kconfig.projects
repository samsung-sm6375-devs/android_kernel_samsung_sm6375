## arch/arm64/Kconfig.projects
```kconfig
config SEC_A23XQ_PROJECT
	default n
	bool "Samsung A23XQ Project"
	help
	  Support for Samsung A23XQ Project

config MACH_A23XQ_EUR_OPEN
	default n
	bool "Samsung A23XQ EUR OPEN"
	help
	  Support for Samsung A23XQ EUR OPEN device.

config SEC_GTA9PWIFI_PROJECT
	default n
	bool "Samsung GTA9P Project"
	help
	  Support for Samsung GTA9P Project

config MACH_GTA9PWIFI_EUR_OPEN
	default n
	bool "Samsung GTA9PWiFi EUR OPENX"
	help
	  support for Samsung GTA9PWiFi EUR OPENX device.
```
